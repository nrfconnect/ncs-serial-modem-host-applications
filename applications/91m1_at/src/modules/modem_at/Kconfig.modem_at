## applications/91m1_at/src/modules/modem_at/Kconfig.modem_at
```kconfig
#
# Copyright (c) 2026 Nordic Semiconductor ASA
#
# SPDX-License-Identifier: LicenseRef-Nordic-5-Clause
#

menuconfig APP_MODEM_AT
	bool "Modem AT handler (Serial Modem UART)"
	default y
	select MODEM_MODULES
	select MODEM_CHAT
	select MODEM_PIPE
	select MODEM_BACKEND_UART
	help
	  Owns the UART to the Serial Modem. Provides a shared AT request/response
	  API and routes the modem's URCs to the application modules.

if APP_MODEM_AT

config APP_MODEM_AT_SHELL
	bool "at shell command"
	default y if SHELL
	help
	  Adds the interactive `at "<command>"` shell on top of the shared handler.

config APP_MODEM_AT_COMMAND_MAX_SIZE
	int "Maximum AT command length"
	default 256

config APP_MODEM_AT_RESPONSE_MAX_SIZE
	int "Maximum collected AT response size"
	default 1024

config APP_MODEM_AT_CHAT_RECEIVE_BUF_SIZE
	int "Chat receive buffer size"
	default 1024
	help
	  Must hold the longest single response line (e.g. an attestation token from
	  %ATTESTTOKEN) plus the longest match.

config APP_MODEM_AT_UART_RX_BUF_SIZE
	int "UART receive buffer size"
	default 1024

config APP_MODEM_AT_UART_TX_BUF_SIZE
	int "UART transmit buffer size"
	default 512

config APP_MODEM_AT_TIMEOUT_SECONDS
	int "Default AT command timeout (seconds)"
	default 30

config APP_MODEM_AT_WAIT_TIMEOUT_SECONDS
	int "Max time to wait for the AT channel if another module is using it"
	default 60
	help
	  How long modem_at_run() waits for another module's command to finish.
	  Set it to at least the slowest AT command timeout of the modules sharing
	  the channel.

config APP_MODEM_AT_URC_SUBSCRIBERS
	int "Maximum URC subscribers"
	default 4

config APP_MODEM_AT_URC_WAITERS
	int "Maximum concurrent URC waits"
	default 2
	help
	  Number of modem_at_run_wait_urc() calls that can wait for their URC at the
	  same time, one per module that uses it.

config APP_MODEM_AT_URC_MAX_SIZE
	int "Maximum URC argument length"
	default 128
	help
	  Buffer for the arguments of a URC that no waiter or subscriber handles,
	  before it is collected or logged.

module = APP_MODEM_AT
module-str = modem_at
source "subsys/logging/Kconfig.template.log_config"

endif # APP_MODEM_AT
```

## applications/93m1_at/src/modules/location/Kconfig.location
```kconfig
#
# Copyright (c) 2026 Nordic Semiconductor ASA
#
# SPDX-License-Identifier: LicenseRef-Nordic-5-Clause
#

menuconfig APP_LOCATION
	bool "Location module"
	default y
	depends on APP_MODEM_AT
	help
	  Requests an nRF Cloud location fix with AT%NRFCLOUDLOCATION. Driven by the
	  sync state machine in main.

if APP_LOCATION

config APP_LOCATION_THREAD_STACK_SIZE
	int "Location thread stack size (bytes)"
	default 1024

config APP_LOCATION_METHOD
	int "Location data collection method (1-7)"
	default 5
	range 1 7
	help
	  The AT%NRFCLOUDLOCATION method parameter, a bitmask of 1 = single-cell,
	  2 = multicell and 4 = Wi-Fi. For example, 5 is Wi-Fi and single-cell.

config APP_LOCATION_AT_TIMEOUT_SECONDS
	int "AT%NRFCLOUDLOCATION timeout (seconds)"
	default 60

config APP_LOCATION_WATCHDOG_TIMEOUT_SECONDS
	int "Watchdog timeout"
	default 150

config APP_LOCATION_MSG_PROCESSING_TIMEOUT_SECONDS
	int "Maximum message processing time"
	default 130
	help
	  Must exceed CONFIG_APP_MODEM_AT_PIPE_WAIT_TIMEOUT_SECONDS plus
	  CONFIG_APP_LOCATION_AT_TIMEOUT_SECONDS.

module = APP_LOCATION
module-str = location
source "subsys/logging/Kconfig.template.log_config"

endif # APP_LOCATION
```

## applications/93m1_at/src/modules/modem_at/Kconfig.modem_at
```kconfig
#
# Copyright (c) 2026 Nordic Semiconductor ASA
#
# SPDX-License-Identifier: LicenseRef-Nordic-5-Clause
#

menuconfig APP_MODEM_AT
	bool "Modem AT handler (shared DLCI 3)"
	default y
	select MODEM_AT_USER_PIPE
	help
	  Shared AT request/response API over the modem's host pipe (DLCI 3).

if APP_MODEM_AT

config APP_MODEM_AT_SHELL
	bool "at shell command"
	default y if SHELL
	help
	  Adds the interactive `at "<command>"` shell on top of the shared handler.

config APP_MODEM_AT_COMMAND_MAX_SIZE
	int "Maximum AT command length"
	default 256

config APP_MODEM_AT_RESPONSE_MAX_SIZE
	int "Maximum collected AT response size"
	default 1024

config APP_MODEM_AT_CHAT_RECEIVE_BUF_SIZE
	int "Chat receive buffer size"
	default 1024
	help
	  Must hold the longest single response line (e.g. a registration JWT from
	  %REGJWT) plus the longest match.

config APP_MODEM_AT_TIMEOUT_SECONDS
	int "Default AT command timeout (seconds)"
	default 30

config APP_MODEM_AT_PIPE_WAIT_TIMEOUT_SECONDS
	int "Max time to wait for the AT pipe if another module is using it"
	default 60
	help
	  How long modem_at_run() waits for another module's command to finish.
	  Set it to at least the slowest AT command timeout of the modules sharing
	  the pipe.

config APP_MODEM_AT_URC_SUBSCRIBERS
	int "Maximum URC subscribers"
	default 4

module = APP_MODEM_AT
module-str = modem_at
source "subsys/logging/Kconfig.template.log_config"

endif # APP_MODEM_AT
```

## applications/ppp/src/modules/fota/Kconfig.fota
```kconfig
#
# Copyright (c) 2026 Nordic Semiconductor ASA
#
# SPDX-License-Identifier: LicenseRef-Nordic-5-Clause
#

menuconfig APP_FOTA
	bool "FOTA"
	default y

if APP_FOTA

config APP_FOTA_SHELL
	bool "FOTA module shell commands"
	default y if SHELL
	help
	  Enable shell commands for the FOTA module.

config APP_FOTA_THREAD_STACK_SIZE
	int "Thread stack size"
	default 4096

config APP_FOTA_WATCHDOG_TIMEOUT_SECONDS
	int "Watchdog timeout"
	default 300
	help
	  Timeout for the FOTA module watchdog, covering both waiting for a message
	  and processing it. The download is callback driven, but the job poll makes
	  blocking CoAP calls, so the timeout matches the cloud module.
	  Must be greater than CONFIG_APP_FOTA_MSG_PROCESSING_TIMEOUT_SECONDS.

config APP_FOTA_MSG_PROCESSING_TIMEOUT_SECONDS
	int "Maximum message processing time"
	default 290
	help
	  Maximum time allowed for processing a single message in the module's state machine.
	  The value must be smaller than CONFIG_APP_FOTA_WATCHDOG_TIMEOUT_SECONDS.

module = APP_FOTA
module-str = FOTA
source "subsys/logging/Kconfig.template.log_config"

endif # APP_FOTA
```

## applications/ppp/src/modules/location/Kconfig.location
```kconfig
#
# Copyright (c) 2026 Nordic Semiconductor ASA
#
# SPDX-License-Identifier: LicenseRef-Nordic-5-Clause
#

menuconfig APP_LOCATION
	bool "Location module"
	default y if LOCATION || DT_HAS_NORDIC_NRF93M1_ENABLED
	depends on NRF_CLOUD_COAP
	depends on LOCATION || (APP_MODEM_AT && DT_HAS_NORDIC_NRF93M1_ENABLED)
	help
	  Collects location measurements and publishes them for the cloud module
	  to resolve into a position with the nRF Cloud ground-fix service.

if APP_LOCATION

choice APP_LOCATION_BACKEND
	prompt "Location measurement backend"
	default APP_LOCATION_BACKEND_MODEM_AT if DT_HAS_NORDIC_NRF93M1_ENABLED
	default APP_LOCATION_BACKEND_LOCATION_LIB

# Don't select CONFIG_LOCATION_DATA_DETAILS: it pulls in <nrf_modem_gnss.h>, which needs
# the nRF Modem Library.
config APP_LOCATION_BACKEND_LOCATION_LIB
	bool "Location library"
	depends on LOCATION
	help
	  Scans for Wi-Fi access points on the host, for example with an nRF7002
	  EB II, through the Location library.

config APP_LOCATION_BACKEND_MODEM_AT
	bool "Modem AT commands"
	depends on APP_MODEM_AT && DT_HAS_NORDIC_NRF93M1_ENABLED
	help
	  Scrapes single-cell (%BCINFO) and Wi-Fi (%WIFISCAN) measurements from the
	  nRF93M1 over the shared AT pipe.

endchoice

config APP_LOCATION_SHELL
	bool "location shell command"
	default y if SHELL
	help
	  Adds `location search` and `location cancel` to start or cancel a
	  location search on demand.

config APP_LOCATION_THREAD_STACK_SIZE
	int "Thread stack size"
	default 4096 if APP_LOCATION_BACKEND_MODEM_AT
	default 2560
	help
	  The modem AT backend builds the %BCINFO and %WIFISCAN requests and parses
	  their responses on this stack.

config APP_LOCATION_WATCHDOG_TIMEOUT_SECONDS
	int "Watchdog timeout"
	default 120
	help
	  Timeout for the location module watchdog, covering both waiting for a
	  message and processing it. The modem AT backend blocks on its cell and
	  Wi-Fi scans.
	  Must be greater than CONFIG_APP_LOCATION_MSG_PROCESSING_TIMEOUT_SECONDS.

config APP_LOCATION_MSG_PROCESSING_TIMEOUT_SECONDS
	int "Maximum message processing time"
	default 100
	help
	  Maximum time allowed for processing a single message in the module's state machine.
	  With the modem AT backend, it must exceed
	  2 * CONFIG_APP_LOCATION_BCINFO_TIMEOUT_SECONDS +
	  CONFIG_APP_LOCATION_BCINFO_RETRY_DELAY_SECONDS +
	  CONFIG_APP_LOCATION_WIFISCAN_TIMEOUT_SECONDS.
	  The value must be smaller than CONFIG_APP_LOCATION_WATCHDOG_TIMEOUT_SECONDS.

config APP_LOCATION_WIFI_APS_MAX
	int "Maximum number of Wi-Fi APs"
	default 6 if APP_LOCATION_BACKEND_MODEM_AT
	default 10
	help
	  Maximum number of Wi-Fi access points to store in a location request.

if APP_LOCATION_BACKEND_MODEM_AT

config APP_LOCATION_AT_RESPONSE_SIZE
	int "AT response buffer size"
	default 2048
	help
	  Must hold the largest %BCINFO/%WIFISCAN response (up to 21 cells).

config APP_LOCATION_BCINFO_TIMEOUT_SECONDS
	int "%BCINFO command timeout (seconds)"
	default 30

config APP_LOCATION_WIFISCAN_TIMEOUT_SECONDS
	int "%WIFISCAN command timeout (seconds)"
	default 30

config APP_LOCATION_BCINFO_RETRY_DELAY_SECONDS
	int "%BCINFO retry delay (seconds)"
	default 5
	help
	  Wait before retrying a failed %BCINFO. The modem answers ERROR while
	  another command, such as the cellular driver's periodic %BCINFO on its
	  own channel, is still running. A %WIFISCAN sent into that window returns
	  no access points and leaves Wi-Fi scanning disabled until the modem is
	  reset, so the delay must outlast the driver's 4 s measurement limit.

endif # APP_LOCATION_BACKEND_MODEM_AT

module = APP_LOCATION
module-str = Location
source "subsys/logging/Kconfig.template.log_config"

endif # APP_LOCATION
```

## applications/ppp/src/modules/network/Kconfig.network
```kconfig
#
# Copyright (c) 2026 Nordic Semiconductor ASA
#
# SPDX-License-Identifier: LicenseRef-Nordic-5-Clause
#

menuconfig APP_NETWORK
	bool "Network module"
	default y

if APP_NETWORK

config APP_NETWORK_THREAD_STACK_SIZE
	int "Thread stack size"
	default 2048

config APP_NETWORK_WATCHDOG_TIMEOUT_SECONDS
	int "Watchdog timeout"
	default 120
	help
	  Bringing the interface down blocks for up to 30 s in the modem_cellular
	  driver while it suspends the modem.
	  Must be greater than CONFIG_APP_NETWORK_MSG_PROCESSING_TIMEOUT_SECONDS.

config APP_NETWORK_MSG_PROCESSING_TIMEOUT_SECONDS
	int "Maximum message processing time"
	default 110
	help
	  Must exceed the 30 s the modem_cellular driver can block while suspending.
	  The value must be smaller than CONFIG_APP_NETWORK_WATCHDOG_TIMEOUT_SECONDS.

config APP_NETWORK_SEARCH_NETWORK_ON_STARTUP
	bool "Connect to network on startup"
	default y

module = APP_NETWORK
module-str = Network
source "subsys/logging/Kconfig.template.log_config"

endif
```
