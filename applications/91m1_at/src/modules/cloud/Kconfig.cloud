## applications/93m1_at/src/modules/location/Kconfig.location
```kconfig
#
# Copyright (c) 2026 Nordic Semiconductor ASA
#
# SPDX-License-Identifier: LicenseRef-Nordic-5-Clause
#

menuconfig APP_LOCATION
	bool "Location module"
	default y
	depends on APP_MODEM_AT
	help
	  Requests an nRF Cloud location fix with AT%NRFCLOUDLOCATION. Driven by the
	  sync state machine in main.

if APP_LOCATION

config APP_LOCATION_THREAD_STACK_SIZE
	int "Location thread stack size (bytes)"
	default 1024

config APP_LOCATION_METHOD
	int "Location data collection method (1-7)"
	default 5
	range 1 7
	help
	  The AT%NRFCLOUDLOCATION method parameter. See the AT command reference for details.
	  The value is a bitmask of 1 = single-cell, 2 = multicell and 4 = Wi-Fi:
	  1: Single-cell only
	  2: Multicell only
	  3: Single-cell and multicell
	  4: Wi-Fi only
	  5: Wi-Fi and single-cell
	  6: Wi-Fi and multicell
	  7: Wi-Fi, single-cell and multicell

config APP_LOCATION_AT_TIMEOUT_SECONDS
	int "AT%NRFCLOUDLOCATION timeout (seconds)"
	default 60

config APP_LOCATION_WATCHDOG_TIMEOUT_SECONDS
	int "Watchdog timeout"
	default 150

config APP_LOCATION_MSG_PROCESSING_TIMEOUT_SECONDS
	int "Maximum message processing time"
	default 130
	help
	  modem_at_run() shares one AT pipe with other modules. This value must
	  exceed CONFIG_APP_MODEM_AT_PIPE_WAIT_TIMEOUT_SECONDS plus
	  CONFIG_APP_LOCATION_AT_TIMEOUT_SECONDS to cover that combined worst case.

module = APP_LOCATION
module-str = location
source "subsys/logging/Kconfig.template.log_config"

endif # APP_LOCATION
```

## applications/93m1_ppp/src/Kconfig.main
```kconfig
#
# Copyright (c) 2026 Nordic Semiconductor
#
# SPDX-License-Identifier: LicenseRef-Nordic-5-Clause
#

menu "Main"

config APP_MAIN_WATCHDOG_TIMEOUT_SECONDS
	int "Watchdog timeout"
	default 120

config APP_MAIN_MSG_PROCESSING_TIMEOUT_SECONDS
	int "Maximum message processing time"
	default 110

config APP_MAIN_SYNC_BOOT_DELAY_SECONDS
	int "Delay before the first sync after connect (seconds)"
	default 10
	help
	  Lets the CoAP session settle before the first location fix and
	  FOTA poll.

config APP_MAIN_SYNC_INTERVAL_SECONDS
	int "Cloud synchronization interval (seconds)"
	default 600
	help
	  Time between cloud synchronizations while the network is connected.
	  The first one runs APP_MAIN_SYNC_BOOT_DELAY_SECONDS after connect.
	  Each one:

	  - Posts pending Memfault data (CONFIG_APP_CLOUD only).
	  - Requests a location fix (CONFIG_APP_LOCATION only).
	  - Polls for a FOTA job (CONFIG_APP_FOTA only).

	  If no cloud session can be established, the location and FOTA
	  steps are skipped until the next synchronization.

module = APP_MAIN
module-str = Main
source "subsys/logging/Kconfig.template.log_config"

endmenu
```

## applications/93m1_ppp/src/modules/battery/Kconfig.battery
```kconfig
#
# Copyright (c) 2026 Nordic Semiconductor ASA
#
# SPDX-License-Identifier: LicenseRef-Nordic-5-Clause
#

menuconfig APP_BATTERY
	bool "Battery module"
	depends on NRF_FUEL_GAUGE && NPM13XX_CHARGER
	default y

if APP_BATTERY

config APP_BATTERY_SAMPLE_INTERVAL_SECONDS
	int "Fuel gauge sample interval"
	default 60

config APP_BATTERY_THREAD_STACK_SIZE
	int "Thread stack size"
	default 2048

config APP_BATTERY_WATCHDOG_TIMEOUT_SECONDS
	int "Watchdog timeout"
	default 60
	help
	  Ensure that this value exceeds CONFIG_APP_BATTERY_MSG_PROCESSING_TIMEOUT_SECONDS.

config APP_BATTERY_MSG_PROCESSING_TIMEOUT_SECONDS
	int "Maximum message processing time"
	default 30
	help
	  The value must be smaller than CONFIG_APP_BATTERY_WATCHDOG_TIMEOUT_SECONDS.

module = APP_BATTERY
module-str = Battery
source "subsys/logging/Kconfig.template.log_config"

endif # APP_BATTERY
```

## applications/93m1_ppp/src/modules/buttons/Kconfig.buttons
```kconfig
#
# Copyright (c) 2026 Nordic Semiconductor ASA
#
# SPDX-License-Identifier: LicenseRef-Nordic-5-Clause
#

menuconfig APP_BUTTONS
	bool "Buttons module"
	select DK_LIBRARY
	default y
	help
	  Reports physical button presses on button_chan. What each button
	  number means is decided by the modules observing that channel.

if APP_BUTTONS

module = APP_BUTTONS
module-str = Buttons
source "subsys/logging/Kconfig.template.log_config"

endif # APP_BUTTONS
```

## applications/93m1_ppp/src/modules/cloud/Kconfig.cloud
```kconfig
#
# Copyright (c) 2026 Nordic Semiconductor ASA
#
# SPDX-License-Identifier: LicenseRef-Nordic-5-Clause
#

menuconfig APP_CLOUD
	bool "Cloud module"
	depends on MEMFAULT && NRF_CLOUD_COAP && MEMFAULT_USE_NRF_CLOUD_COAP
	default y

if APP_CLOUD

config APP_CLOUD_THREAD_STACK_SIZE
	int "Thread stack size"
	default 10240
	help
	  Sizes the requests issued on the nRF Cloud CoAP session: the diagnostics
	  chunk upload and the ground-fix request built from the measurements
	  reported by the location module. The DTLS session is owned by the nRF
	  Cloud CoAP client on its own thread, and the mbedTLS buffers are
	  heap-allocated, so neither contributes here.

config APP_CLOUD_WATCHDOG_TIMEOUT_SECONDS
	int "Watchdog timeout"
	default 300

config APP_CLOUD_MSG_PROCESSING_TIMEOUT_SECONDS
	int "Maximum message processing time"
	default 290

module = APP_CLOUD
module-str = Cloud
source "subsys/logging/Kconfig.template.log_config"

endif # APP_CLOUD
```

## applications/93m1_ppp/src/modules/location/Kconfig.location
```kconfig
#
# Copyright (c) 2026 Nordic Semiconductor ASA
#
# SPDX-License-Identifier: LicenseRef-Nordic-5-Clause
#

menuconfig APP_LOCATION
	bool "Location module"
	default y
	depends on APP_MODEM_AT
	depends on NRF_CLOUD_COAP
	help
	  Scrapes single-cell (%BCINFO) and Wi-Fi (%WIFISCAN) measurements over the
	  shared AT pipe and resolves them to a position via the nRF Cloud ground-fix
	  service over the shared CoAP/DTLS session.

if APP_LOCATION

config APP_LOCATION_MAX_WIFI_APS
	int "Maximum Wi-Fi APs per fix"
	default 6

config APP_LOCATION_SHELL
	bool "location shell command"
	default y if SHELL
	help
	  Adds `location fix` to trigger an on-demand fix (useful for bring-up).

config APP_LOCATION_THREAD_STACK_SIZE
	int "Thread stack size"
	default 4096
	help
	  Sizes the %BCINFO and %WIFISCAN requests over the shared AT pipe and the
	  parsing of their responses. Resolving the measurements to a position is
	  the responsibility of the cloud module, so no CoAP request is built here.

config APP_LOCATION_AT_RESPONSE_SIZE
	int "AT response buffer size"
	default 2048
	help
	  Must hold the largest %BCINFO/%WIFISCAN response (up to 21 cells).

config APP_LOCATION_BCINFO_TIMEOUT_SECONDS
	int "%BCINFO command timeout (seconds)"
	default 30

config APP_LOCATION_WIFISCAN_TIMEOUT_SECONDS
	int "%WIFISCAN command timeout (seconds)"
	default 30

module = APP_LOCATION
module-str = location
source "subsys/logging/Kconfig.template.log_config"

endif # APP_LOCATION
```

## applications/ppp/src/modules/cloud/Kconfig.cloud
```kconfig
#
# Copyright (c) 2026 Nordic Semiconductor ASA
#
# SPDX-License-Identifier: LicenseRef-Nordic-5-Clause
#

menuconfig APP_CLOUD
	bool "Cloud module"
	default y
	depends on MEMFAULT && NRF_CLOUD_COAP && MEMFAULT_USE_NRF_CLOUD_COAP

if APP_CLOUD

config APP_CLOUD_THREAD_STACK_SIZE
	int "Cloud module thread stack size"
	default 10240
	help
	  Sizes the requests issued on the nRF Cloud CoAP session: the device
	  message, the device shadow poll, the Memfault data upload and the
	  ground-fix request built from the measurements reported by the
	  location module. The DTLS session is owned by the nRF Cloud CoAP
	  client on its own thread, and the mbedTLS buffers are heap-allocated,
	  so neither contributes here.

config APP_CLOUD_WATCHDOG_TIMEOUT_SECONDS
	int "Watchdog timeout"
	default 300

config APP_CLOUD_MSG_PROCESSING_TIMEOUT_SECONDS
	int "Maximum message processing time"
	default 290

config APP_CLOUD_MSG_MAX_LEN
	int "Maximum device message length"
	default 512

config APP_CLOUD_SHADOW_MAX_LEN
	int "Maximum device shadow desired buffer length"
	default 1024

config APP_CLOUD_CREDENTIAL_RETRY_SECONDS
	int "Retry interval when credentials are missing"
	default 10

module = APP_CLOUD
module-str = Cloud
source "subsys/logging/Kconfig.template.log_config"

endif # APP_CLOUD
```

## applications/ppp/src/modules/fota/Kconfig.fota
```kconfig
#
# Copyright (c) 2026 Nordic Semiconductor ASA
#
# SPDX-License-Identifier: LicenseRef-Nordic-5-Clause
#

menuconfig APP_FOTA
	bool "FOTA"
	default y

if APP_FOTA

config APP_FOTA_SHELL
	bool "FOTA module shell commands"
	default y if SHELL
	help
	  Enable shell commands for the FOTA module.

config APP_FOTA_THREAD_STACK_SIZE
	int "Thread stack size"
	default 4096

config APP_FOTA_WATCHDOG_TIMEOUT_SECONDS
	int "Watchdog timeout"
	default 300
	help
	  Timeout in seconds for the FOTA module watchdog.
	  The timeout given in this option covers both:
	    * Waiting for an incoming message in zbus_sub_wait_msg().
	    * Time spent processing the message, defined by
	      CONFIG_APP_FOTA_MSG_PROCESSING_TIMEOUT_SECONDS.
	  The image download does not run in a handler: the module uses the nRF Cloud
	  FOTA poll library in non-blocking mode (a status callback is provided), so
	  nrf_cloud_fota_poll_process() starts the download and returns, and the
	  download is driven by callbacks. What still blocks is the poll itself, which
	  makes reliable CoAP calls to check for and report the job, plus a short wait
	  inside the library after a job update. This is the same class of blocking as
	  the Cloud module, which is why the timeout matches it.
	  Ensure that this value exceeds CONFIG_APP_FOTA_MSG_PROCESSING_TIMEOUT_SECONDS.

config APP_FOTA_MSG_PROCESSING_TIMEOUT_SECONDS
	int "Maximum message processing time"
	default 290
	help
	  Maximum time allowed for processing a single message in the module's state machine.
	  The value must be smaller than CONFIG_APP_FOTA_WATCHDOG_TIMEOUT_SECONDS.

module = APP_FOTA
module-str = FOTA
source "subsys/logging/Kconfig.template.log_config"

endif # APP_FOTA
```

## applications/ppp/src/modules/led/Kconfig.led
```kconfig
#
# Copyright (c) 2026 Nordic Semiconductor ASA
#
# SPDX-License-Identifier: LicenseRef-Nordic-5-Clause
#

menuconfig APP_LED
	bool "LED module"
	depends on $(dt_alias_enabled,led-red)
	depends on $(dt_alias_enabled,led-green)
	depends on $(dt_alias_enabled,led-blue)
	select GPIO
	default y
	help
	  Drives the host RGB LED from patterns published on led_chan.
	  Requires the led-red, led-green and led-blue devicetree aliases.

if APP_LED

module = APP_LED
module-str = LED
source "subsys/logging/Kconfig.template.log_config"

endif # APP_LED
```

## applications/ppp/src/modules/location/Kconfig.location
```kconfig
#
# Copyright (c) 2026 Nordic Semiconductor ASA
#
# SPDX-License-Identifier: LicenseRef-Nordic-5-Clause
#

menuconfig APP_LOCATION
	bool "Location module"
	default y if LOCATION || DT_HAS_NORDIC_NRF93M1_ENABLED
	depends on NRF_CLOUD_COAP
	depends on LOCATION || (APP_MODEM_AT && DT_HAS_NORDIC_NRF93M1_ENABLED)
	help
	  Collects location measurements and publishes them for the cloud module
	  to resolve into a position with the nRF Cloud ground-fix service.

if APP_LOCATION

choice APP_LOCATION_BACKEND
	prompt "Location measurement backend"
	default APP_LOCATION_BACKEND_MODEM_AT if DT_HAS_NORDIC_NRF93M1_ENABLED
	default APP_LOCATION_BACKEND_LOCATION_LIB

# CONFIG_LOCATION_DATA_DETAILS is deliberately not selected: it makes
# <modem/location.h> include <nrf_modem_gnss.h>, which is only available when the
# nRF Modem Library is built, and the modem is external on this host.
config APP_LOCATION_BACKEND_LOCATION_LIB
	bool "Location library"
	depends on LOCATION
	help
	  Scans for Wi-Fi access points on the host, for example with an nRF7002
	  EB II, through the Location library.

config APP_LOCATION_BACKEND_MODEM_AT
	bool "Modem AT commands"
	depends on APP_MODEM_AT && DT_HAS_NORDIC_NRF93M1_ENABLED
	help
	  Scrapes single-cell (%BCINFO) and Wi-Fi (%WIFISCAN) measurements from the
	  nRF93M1 over the shared AT pipe.

endchoice

config APP_LOCATION_SHELL
	bool "location shell command"
	default y if SHELL
	help
	  Adds `location search` and `location cancel` to start or cancel a
	  location search on demand.

config APP_LOCATION_THREAD_STACK_SIZE
	int "Thread stack size"
	default 4096 if APP_LOCATION_BACKEND_MODEM_AT
	default 2560
	help
	  The modem AT backend sizes the %BCINFO and %WIFISCAN requests over the
	  shared AT pipe and parses their responses on this stack. Resolving the
	  measurements to a position is the responsibility of the cloud module, so
	  no CoAP request is built here.

config APP_LOCATION_WATCHDOG_TIMEOUT_SECONDS
	int "Watchdog timeout"
	default 120
	help
	  Timeout in seconds for the location module watchdog.
	  The timeout given in this option covers both:
	    * Waiting for an incoming message in zbus_sub_wait_msg().
	    * Time spent processing the message, defined by
	      CONFIG_APP_LOCATION_MSG_PROCESSING_TIMEOUT_SECONDS.
	  The Location library backend starts an asynchronous Wi-Fi scan and
	  returns immediately; the scan result arrives later through the Location
	  library callback. The modem AT backend blocks on its cell and Wi-Fi scans,
	  so both backends use timeouts that cover it.
	  Ensure that this value exceeds CONFIG_APP_LOCATION_MSG_PROCESSING_TIMEOUT_SECONDS.

config APP_LOCATION_MSG_PROCESSING_TIMEOUT_SECONDS
	int "Maximum message processing time"
	default 100
	help
	  Maximum time allowed for processing a single message in the module's state machine.
	  With the modem AT backend, it must exceed
	  2 * CONFIG_APP_LOCATION_BCINFO_TIMEOUT_SECONDS +
	  CONFIG_APP_LOCATION_BCINFO_RETRY_DELAY_SECONDS +
	  CONFIG_APP_LOCATION_WIFISCAN_TIMEOUT_SECONDS.
	  The value must be smaller than CONFIG_APP_LOCATION_WATCHDOG_TIMEOUT_SECONDS.

config APP_LOCATION_WIFI_APS_MAX
	int "Maximum number of Wi-Fi APs"
	default 6 if APP_LOCATION_BACKEND_MODEM_AT
	default 10
	help
	  Maximum number of Wi-Fi access points to store in a location request.

if APP_LOCATION_BACKEND_MODEM_AT

config APP_LOCATION_AT_RESPONSE_SIZE
	int "AT response buffer size"
	default 2048
	help
	  Must hold the largest %BCINFO/%WIFISCAN response (up to 21 cells).

config APP_LOCATION_BCINFO_TIMEOUT_SECONDS
	int "%BCINFO command timeout (seconds)"
	default 30

config APP_LOCATION_WIFISCAN_TIMEOUT_SECONDS
	int "%WIFISCAN command timeout (seconds)"
	default 30

config APP_LOCATION_BCINFO_RETRY_DELAY_SECONDS
	int "%BCINFO retry delay (seconds)"
	default 5
	help
	  Wait before retrying a failed %BCINFO. The modem answers ERROR while
	  another command, such as the cellular driver's periodic %BCINFO on its
	  own channel, is still running. A %WIFISCAN sent into that window returns
	  no access points and leaves Wi-Fi scanning disabled until the modem is
	  reset, so the delay must outlast the driver's 4 s measurement limit.

endif # APP_LOCATION_BACKEND_MODEM_AT

module = APP_LOCATION
module-str = Location
source "subsys/logging/Kconfig.template.log_config"

endif # APP_LOCATION
```
