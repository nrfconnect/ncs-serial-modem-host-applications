## applications/91m1_at/src/modules/cloud/Kconfig.cloud
```kconfig
#
# Copyright (c) 2026 Nordic Semiconductor ASA
#
# SPDX-License-Identifier: LicenseRef-Nordic-5-Clause
#

menuconfig APP_CLOUD
	bool "Cloud module (nRF Cloud through the Serial Modem)"
	default y
	depends on APP_MODEM_AT
	depends on APP_NETWORK
	help
	  Onboards the Serial Modem to nRF Cloud with its provisioning commands
	  (AT#XNRFPROV) and connects the modem's nRF Cloud client (AT#XNRFCLOUD).
	  The connection state is reported on cloud_chan.

if APP_CLOUD

config APP_CLOUD_THREAD_STACK_SIZE
	int "Thread stack size"
	default 2048

config APP_CLOUD_AT_TIMEOUT_SECONDS
	int "Cloud AT command timeout (seconds)"
	default 30
	help
	  Time to wait for OK from each AT command the module sends.

config APP_CLOUD_PROVISIONING_STEP_TIMEOUT_SECONDS
	int "Provisioning step timeout (seconds)"
	default 180
	help
	  Time to wait for the #XNRFPROV result after each provisioning step. When the
	  host brings LTE back up, the Serial Modem waits up to 120 seconds for the
	  network before it reports the next step.

config APP_CLOUD_CONNECT_TIMEOUT_SECONDS
	int "nRF Cloud connect timeout (seconds)"
	default 60
	help
	  Time to wait for the #XNRFCLOUD result after AT#XNRFCLOUD=1.

config APP_CLOUD_RETRY_SECONDS
	int "Retry interval (seconds)"
	default 60
	help
	  Delay before provisioning or connecting is retried after a failure, for
	  example while the device is not yet claimed in nRF Cloud.

config APP_CLOUD_WATCHDOG_TIMEOUT_SECONDS
	int "Watchdog timeout"
	default 300

config APP_CLOUD_MSG_PROCESSING_TIMEOUT_SECONDS
	int "Maximum message processing time"
	default 290
	help
	  A provisioning step can wait for the shared AT channel
	  (CONFIG_APP_MODEM_AT_WAIT_TIMEOUT_SECONDS), then for OK
	  (CONFIG_APP_CLOUD_AT_TIMEOUT_SECONDS), then for the result
	  (CONFIG_APP_CLOUD_PROVISIONING_STEP_TIMEOUT_SECONDS). This value must exceed
	  that combined worst case.

module = APP_CLOUD
module-str = cloud
source "subsys/logging/Kconfig.template.log_config"

endif # APP_CLOUD
```

## applications/91m1_at/src/modules/location/Kconfig.location
```kconfig
#
# Copyright (c) 2026 Nordic Semiconductor ASA
#
# SPDX-License-Identifier: LicenseRef-Nordic-5-Clause
#

menuconfig APP_LOCATION
	bool "Location module"
	default y
	depends on APP_MODEM_AT
	depends on APP_CLOUD
	help
	  Gets a location fix on request through the Serial Modem, which does all
	  nRF Cloud communication. Neighbour-cell positioning (AT#XNRFCLOUDPOS) is
	  tried first; if it fails, GNSS with nRF Cloud A-GNSS (AT#XGNSS) is used,
	  and the Serial Modem sends the GNSS fix to nRF Cloud.

if APP_LOCATION

config APP_LOCATION_CELL_COUNT
	int "Number of cells in a cellular location request"
	range 1 15
	default 4
	help
	  Passed as <cell_count> to AT#XNRFCLOUDPOS. One gives single-cell
	  positioning; more cells give multicell positioning.

config APP_LOCATION_CELL_TIMEOUT_SECONDS
	int "Cellular location timeout (seconds)"
	default 60
	help
	  Time to wait for the #XNRFCLOUDPOS result. This covers the neighbour cell
	  measurements and the nRF Cloud round trip.

config APP_LOCATION_GNSS
	bool "Fall back to GNSS"
	default y
	help
	  Run a single GNSS fix with nRF Cloud A-GNSS when cellular positioning fails.

if APP_LOCATION_GNSS

config APP_LOCATION_GNSS_TIMEOUT_SECONDS
	int "GNSS fix timeout (seconds)"
	default 120
	help
	  Passed as <timeout> to AT#XGNSS. GNSS only runs while LTE is idle, so the
	  fix takes longer than with LTE off.

config APP_LOCATION_GNSS_ANTENNA_CMD
	string "GNSS antenna configuration command"
	default "AT%XCOEX0=1,1,1565,1586"
	help
	  Sent once before the first GNSS fix. The default enables the onboard GNSS
	  antenna of the nRF9151 DK. Leave empty to skip.

endif # APP_LOCATION_GNSS

config APP_LOCATION_THREAD_STACK_SIZE
	int "Thread stack size"
	default 2048

config APP_LOCATION_WATCHDOG_TIMEOUT_SECONDS
	int "Watchdog timeout"
	default 300

config APP_LOCATION_MSG_PROCESSING_TIMEOUT_SECONDS
	int "Maximum message processing time"
	default 290
	help
	  Each attempt (cellular, then GNSS) is handled as its own message. A single
	  attempt can wait for the shared AT channel, then for OK, then for its
	  result, and this value must exceed that combined worst case.

module = APP_LOCATION
module-str = location
source "subsys/logging/Kconfig.template.log_config"

endif # APP_LOCATION
```

## applications/91m1_at/src/modules/modem_at/Kconfig.modem_at
```kconfig
#
# Copyright (c) 2026 Nordic Semiconductor ASA
#
# SPDX-License-Identifier: LicenseRef-Nordic-5-Clause
#

menuconfig APP_MODEM_AT
	bool "Modem AT handler (Serial Modem UART)"
	default y
	select MODEM_MODULES
	select MODEM_CHAT
	select MODEM_PIPE
	select MODEM_BACKEND_UART
	help
	  Owns the UART to the Serial Modem. Provides a shared AT request/response
	  API and routes the modem's URCs to the application modules.

if APP_MODEM_AT

config APP_MODEM_AT_SHELL
	bool "at shell command"
	default y if SHELL
	help
	  Adds the interactive `at "<command>"` shell on top of the shared handler.

config APP_MODEM_AT_COMMAND_MAX_SIZE
	int "Maximum AT command length"
	default 256

config APP_MODEM_AT_RESPONSE_MAX_SIZE
	int "Maximum collected AT response size"
	default 1024

config APP_MODEM_AT_CHAT_RECEIVE_BUF_SIZE
	int "Chat receive buffer size"
	default 1024
	help
	  Must hold the longest single response line (e.g. an attestation token from
	  %ATTESTTOKEN) plus the longest match.

config APP_MODEM_AT_UART_RX_BUF_SIZE
	int "UART receive buffer size"
	default 1024

config APP_MODEM_AT_UART_TX_BUF_SIZE
	int "UART transmit buffer size"
	default 512

config APP_MODEM_AT_TIMEOUT_SECONDS
	int "Default AT command timeout (seconds)"
	default 30

config APP_MODEM_AT_WAIT_TIMEOUT_SECONDS
	int "Max time to wait for the AT channel if another module is using it"
	default 60
	help
	  modem_at_run() shares one AT channel across modules. This bounds how long a
	  call will wait for another module's in-progress command to finish before
	  giving up. Should be at least as long as the slowest AT command timeout
	  among the modules sharing the channel, so a caller does not give up on a
	  still-legitimate exchange.

config APP_MODEM_AT_URC_SUBSCRIBERS
	int "Maximum URC subscribers"
	default 4

config APP_MODEM_AT_URC_WAITERS
	int "Maximum concurrent URC waits"
	default 2
	help
	  Number of modem_at_run_wait_urc() calls that can wait for their URC at the
	  same time, one per module that uses it.

config APP_MODEM_AT_URC_MAX_SIZE
	int "Maximum URC argument length"
	default 128
	help
	  Buffer for the arguments of a URC that no waiter or subscriber handles,
	  before it is collected or logged.

module = APP_MODEM_AT
module-str = modem_at
source "subsys/logging/Kconfig.template.log_config"

endif # APP_MODEM_AT
```

## applications/91m1_at/src/modules/modem_power/Kconfig.modem_power
```kconfig
#
# Copyright (c) 2026 Nordic Semiconductor ASA
#
# SPDX-License-Identifier: LicenseRef-Nordic-5-Clause
#

menuconfig APP_MODEM_POWER
	bool "Modem power saving"
	default y
	depends on APP_MODEM_AT
	help
	  Apply the modem power saving settings over the Serial Modem UART each time the
	  network connects: PSM, and proprietary PSM for when the network does not grant
	  it. PSM also gives GNSS time to run while LTE is idle.

if APP_MODEM_POWER

config APP_MODEM_POWER_PSM_TAU
	string "Requested periodic TAU (T3412 extended)"
	default "00101100"
	help
	  Bit string for AT+CPSMS. The default requests 12 hours. The network decides
	  the granted value.

config APP_MODEM_POWER_PSM_ACTIVE_TIME
	string "Requested active time (T3324)"
	default "00000010"
	help
	  Bit string for AT+CPSMS. The default requests 4 seconds. The network decides
	  the granted value.

config APP_MODEM_POWER_CMD_TIMEOUT_SECONDS
	int "AT command timeout"
	default 5

module = APP_MODEM_POWER
module-str = Modem power
source "subsys/logging/Kconfig.template.log_config"

endif # APP_MODEM_POWER
```

## applications/91m1_at/src/modules/network/Kconfig.network
```kconfig
#
# Copyright (c) 2026 Nordic Semiconductor ASA
#
# SPDX-License-Identifier: LicenseRef-Nordic-5-Clause
#

menuconfig APP_NETWORK
	bool "Network module"
	default y
	depends on APP_MODEM_AT
	help
	  Configures the Serial Modem at start-up, brings LTE up and down with
	  AT+CFUN, and reports the LTE registration state from +CEREG over zbus.
	  The host runs no IP stack; the modem's own clients use the link.

if APP_NETWORK

config APP_NETWORK_THREAD_STACK_SIZE
	int "Thread stack size"
	default 2048

config APP_NETWORK_MODEM_READY_TIMEOUT_SECONDS
	int "Time to wait for the Serial Modem to answer at start-up (seconds)"
	default 30

config APP_NETWORK_WATCHDOG_TIMEOUT_SECONDS
	int "Watchdog timeout"
	default 300

config APP_NETWORK_MSG_PROCESSING_TIMEOUT_SECONDS
	int "Maximum message processing time"
	default 290

config APP_NETWORK_SEARCH_NETWORK_ON_STARTUP
	bool "Connect to network on startup"
	default y

module = APP_NETWORK
module-str = Network
source "subsys/logging/Kconfig.template.log_config"

endif
```

## applications/91m1_ppp/src/Kconfig.main
```kconfig
#
# Copyright (c) 2026 Nordic Semiconductor
#
# SPDX-License-Identifier: LicenseRef-Nordic-5-Clause
#

menu "Main"

config APP_MAIN_WATCHDOG_TIMEOUT_SECONDS
	int "Watchdog timeout"
	default 30
	help
	  The module only publishes messages and schedules work in its handlers;
	  it never blocks. The timeout is kept short so a stuck thread is caught
	  quickly, while leaving ample margin over the message processing budget.

config APP_MAIN_MSG_PROCESSING_TIMEOUT_SECONDS
	int "Maximum message processing time"
	default 5

config APP_MAIN_SYNC_INTERVAL_SECONDS
	int "Cloud syncronization interval (seconds)"
	default 600
	help
	  Time between cloud synchronizations while connected to nRF Cloud.
	  A synchronization also runs immediately on connect. Each one:

	  - Sends the demo payload.
	  - Requests a location fix (location overlay only).
	  - Polls the device shadow.
	  - Polls for a FOTA job (CONFIG_APP_FOTA only).
	  - Posts pending Memfault data.

config APP_MAIN_CLOUD_SYNC_WORKQ_STACK_SIZE
	int "Cloud synchronization workqueue stack size"
	default 1024

config APP_MAIN_CLOUD_SYNC_WORKQ_PRIORITY
	int "Cloud synchronization workqueue priority"
	default 5

module = APP_MAIN
module-str = Main
source "subsys/logging/Kconfig.template.log_config"

endmenu
```

## applications/91m1_ppp/sysbuild/mcuboot/boards/nrf54lm20dk_nrf54lm20b_cpuapp.conf
```kconfig
#
# Copyright (c) 2026 Nordic Semiconductor ASA
#
# SPDX-License-Identifier: LicenseRef-Nordic-5-Clause
#

CONFIG_HW_STACK_PROTECTION=n
CONFIG_BOOT_WATCHDOG_FEED=n

CONFIG_GPIO=y
CONFIG_SPI=y
CONFIG_SPI_NOR=y
CONFIG_SPI_NOR_SFDP_DEVICETREE=y
CONFIG_SPI_NOR_FLASH_LAYOUT_PAGE_SIZE=4096

CONFIG_TICKLESS_KERNEL=y

CONFIG_FPROTECT=n
CONFIG_FLASH=y
CONFIG_MAIN_STACK_SIZE=16384

CONFIG_MULTITHREADING=y

CONFIG_LOG=y
CONFIG_LOG_MODE_MINIMAL=y
CONFIG_LOG_DEFAULT_LEVEL=0
CONFIG_MCUBOOT_LOG_LEVEL_INF=y
CONFIG_CBPRINTF_NANO=y
CONFIG_MINIMAL_LIBC=y
```

## applications/93m1_at/src/modules/battery/Kconfig.battery
```kconfig
#
# Copyright (c) 2026 Nordic Semiconductor ASA
#
# SPDX-License-Identifier: LicenseRef-Nordic-5-Clause
#

menuconfig APP_BATTERY
	bool "Battery module"
	default y
	depends on APP_CLOUD && NRF_FUEL_GAUGE && NPM13XX_CHARGER
	help
	  Samples the nPM1300 fuel gauge and publishes state of charge to the cloud
	  module, which forwards it to nRF Cloud.

if APP_BATTERY

config APP_BATTERY_THREAD_STACK_SIZE
	int "Battery thread stack size (bytes)"
	default 2048

config APP_BATTERY_SAMPLE_INTERVAL
	int "Battery sampling interval (seconds)"
	default 60
	help
	  How often the fuel gauge is fed a new sample. Runs regardless of network
	  connectivity.

config APP_BATTERY_WATCHDOG_TIMEOUT_SECONDS
	int "Watchdog timeout"
	default 30

config APP_BATTERY_MSG_PROCESSING_TIMEOUT_SECONDS
	int "Maximum message processing time"
	default 10

module = APP_BATTERY
module-str = battery
source "subsys/logging/Kconfig.template.log_config"

endif # APP_BATTERY
```

## applications/93m1_at/src/modules/buttons/Kconfig.buttons
```kconfig
#
# Copyright (c) 2026 Nordic Semiconductor ASA
#
# SPDX-License-Identifier: LicenseRef-Nordic-5-Clause
#

menuconfig APP_BUTTONS
	bool "Buttons module"
	select DK_LIBRARY
	default y
	help
	  Reports physical button presses on button_chan. What each button
	  number means is decided by the modules observing that channel.

if APP_BUTTONS

config APP_BUTTONS_SHELL
	bool "button shell command"
	default y if SHELL
	help
	  Adds shell support for button presses.

module = APP_BUTTONS
module-str = Buttons
source "subsys/logging/Kconfig.template.log_config"

endif # APP_BUTTONS
```

## applications/93m1_at/src/modules/cloud/Kconfig.cloud
```kconfig
#
# Copyright (c) 2026 Nordic Semiconductor ASA
#
# SPDX-License-Identifier: LicenseRef-Nordic-5-Clause
#

menuconfig APP_CLOUD
	bool "Cloud module (nRF Cloud egress)"
	default y
	depends on APP_MODEM_AT
	help
	  Single owner of outbound nRF Cloud AT traffic. Forwards telemetry that other
	  modules publish to cloud_chan while connected.

if APP_CLOUD

config APP_CLOUD_PAYLOAD_BUFFER
	int "Payload buffer size"
	default 96
	help
	  Size of buffer used to construct JSON payload sent to cloud.

config APP_CLOUD_THREAD_STACK_SIZE
	int "Thread stack size"
	default 2048

config APP_CLOUD_AT_TIMEOUT_SECONDS
	int "Cloud AT command timeout (seconds)"
	default 30

config APP_CLOUD_OBSERVABILITY
	bool "Upload observability data"
	default y
	help
	  Handles the upload request from the sync state machine by running
	  AT%NRFCLOUDOBSUPLOAD, which sends the observability chunks queued on the modem to
	  nRF Cloud. nRF Cloud lists the device as seen, with its hardware and software
	  versions, only after observability data has arrived.

config APP_CLOUD_OBSERVABILITY_HEARTBEAT
	bool "Trigger a heartbeat before each upload"
	default y
	depends on APP_CLOUD_OBSERVABILITY
	help
	  Runs AT%NRFCLOUDOBSHEARTBEAT before each upload so that every sync carries a
	  metrics heartbeat. The modem documentation marks the command for debug use. Turn
	  this off to upload only what the modem has queued on its own.

config APP_CLOUD_OBSERVABILITY_RESPONSE_SIZE
	int "Observability upload response buffer size"
	default 64
	depends on APP_CLOUD_OBSERVABILITY
	help
	  Holds the %NRFCLOUDOBSUPLOAD result line that is logged after an upload.

config APP_CLOUD_WATCHDOG_TIMEOUT_SECONDS
	int "Watchdog timeout"
	default 220 if APP_CLOUD_OBSERVABILITY_HEARTBEAT
	default 120

config APP_CLOUD_MSG_PROCESSING_TIMEOUT_SECONDS
	int "Maximum message processing time"
	default 190 if APP_CLOUD_OBSERVABILITY_HEARTBEAT
	default 100
	help
	  modem_at_run() shares one AT pipe with other modules. This value must exceed
	  CONFIG_APP_MODEM_AT_PIPE_WAIT_TIMEOUT_SECONDS plus CONFIG_APP_CLOUD_AT_TIMEOUT_SECONDS
	  for every AT command a message runs, which is two for an upload with a heartbeat.

module = APP_CLOUD
module-str = cloud
source "subsys/logging/Kconfig.template.log_config"

endif # APP_CLOUD
```
