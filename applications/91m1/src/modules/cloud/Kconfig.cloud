## applications/91m1/src/modules/cloud/Kconfig.cloud
```kconfig
#
# Copyright (c) 2026 Nordic Semiconductor ASA
#
# SPDX-License-Identifier: LicenseRef-Nordic-5-Clause
#

menuconfig APP_CLOUD
	bool "Cloud module"
	default y

if APP_CLOUD

config APP_CLOUD_THREAD_STACK_SIZE
	int "Thread stack size"
	default 6144

config APP_CLOUD_WATCHDOG_TIMEOUT_SECONDS
	int "Watchdog timeout"
	default 300

config APP_CLOUD_MSG_PROCESSING_TIMEOUT_SECONDS
	int "Maximum message processing time"
	default 290

config APP_CLOUD_MSG_MAX_LEN
	int "Maximum device message length"
	default 512

config APP_CLOUD_POLL_INTERVAL_SECONDS
	int "Shadow poll interval for cloud-to-device messages"
	default 30

config APP_CLOUD_CREDENTIAL_RETRY_SECONDS
	int "Retry interval when credentials are missing"
	default 10

module = APP_CLOUD
module-str = Cloud
source "subsys/logging/Kconfig.template.log_config"

endif # APP_CLOUD
```

## applications/91m1_ppp/sysbuild/mcuboot/boards/nrf54l15dk_nrf54l15_cpuapp.conf
```kconfig
#
# Copyright (c) 2026 Nordic Semiconductor ASA
#
# SPDX-License-Identifier: LicenseRef-Nordic-5-Clause
#

# Workaround: disable memory guard to avoid false faults in application after boot
CONFIG_HW_STACK_PROTECTION=n

CONFIG_BOOT_WATCHDOG_FEED=n

# nRF54L15 DK external QSPI NOR (mx25r64)
CONFIG_GPIO=y
CONFIG_SPI=y
CONFIG_SPI_NOR=y
CONFIG_SPI_NOR_SFDP_DEVICETREE=y
CONFIG_SPI_NOR_FLASH_LAYOUT_PAGE_SIZE=4096

# SYSCOUNTER is not restored across MCUboot resets without tickless kernel.
CONFIG_TICKLESS_KERNEL=y

CONFIG_FPROTECT=n
CONFIG_FLASH=y
CONFIG_MAIN_STACK_SIZE=16384

CONFIG_MULTITHREADING=y

CONFIG_LOG=y
CONFIG_LOG_MODE_MINIMAL=y
CONFIG_LOG_DEFAULT_LEVEL=0
CONFIG_MCUBOOT_LOG_LEVEL_INF=y
CONFIG_CBPRINTF_NANO=y
CONFIG_MINIMAL_LIBC=y
```

## applications/93m1/src/Kconfig.main
```kconfig
#
# Copyright (c) 2026 Nordic Semiconductor
#
# SPDX-License-Identifier: LicenseRef-Nordic-5-Clause
#

menu "Main"

config APP_MAIN_WATCHDOG_TIMEOUT_SECONDS
	int "Watchdog timeout"
	default 120

config APP_MAIN_MSG_PROCESSING_TIMEOUT_SECONDS
	int "Maximum message processing time"
	default 110

module = APP_MAIN
module-str = Main
source "subsys/logging/Kconfig.template.log_config"

endmenu
```

## applications/93m1/src/modules/fota/Kconfig.fota
```kconfig
#
# Copyright (c) 2026 Nordic Semiconductor ASA
#
# SPDX-License-Identifier: LicenseRef-Nordic-5-Clause
#

menuconfig APP_FOTA
	bool "FOTA"
	default y if MEMFAULT_ZEPHYR_FOTA_BACKEND_NRF_CLOUD_OVERRIDE

if APP_FOTA

config APP_FOTA_SHELL
	bool "FOTA module shell commands"
	default y if SHELL
	help
	  Enable shell commands for the FOTA module.

config APP_FOTA_THREAD_STACK_SIZE
	int "Thread stack size"
	default 2048

config APP_FOTA_WATCHDOG_TIMEOUT_SECONDS
	int "Watchdog timeout"
	default 210
	help
	  Timeout in seconds for the FOTA module watchdog.
	  The timeout given in this option covers both:
	    * Waiting for an incoming message in zbus_sub_wait_msg().
	    * Time spent processing the message, defined by
	      CONFIG_APP_FOTA_MSG_PROCESSING_TIMEOUT_SECONDS.
	  Ensure that this value exceeds CONFIG_APP_FOTA_MSG_PROCESSING_TIMEOUT_SECONDS.

config APP_FOTA_MSG_PROCESSING_TIMEOUT_SECONDS
	int "Maximum message processing time"
	default 180
	help
	  Maximum time allowed for processing a single message in the module's state machine.
	  The value must be smaller than CONFIG_APP_FOTA_WATCHDOG_TIMEOUT_SECONDS.

module = APP_FOTA
module-str = FOTA
source "subsys/logging/Kconfig.template.log_config"

endif # APP_FOTA
```

## applications/93m1/src/modules/memfault/Kconfig.memfault
```kconfig
#
# Copyright (c) 2026 Nordic Semiconductor ASA
#
# SPDX-License-Identifier: LicenseRef-Nordic-5-Clause
#

menuconfig APP_MEMFAULT
	bool "Memfault module"
	depends on MEMFAULT
	default y

if APP_MEMFAULT

config APP_MEMFAULT_THREAD_STACK_SIZE
	int "Thread stack size"
	default 10240
	help
	  The thread drives the blocking nRF Cloud CoAP upload path (connect +
	  software-DTLS handshake + shadow + chunk post). mbedTLS buffers are
	  heap-allocated, so measured stack use is modest (~2 KB); prj.conf sets 4096.

config APP_MEMFAULT_WATCHDOG_TIMEOUT_SECONDS
	int "Watchdog timeout"
	default 300

config APP_MEMFAULT_MSG_PROCESSING_TIMEOUT_SECONDS
	int "Maximum message processing time"
	default 290

module = APP_MEMFAULT
module-str = Memfault
source "subsys/logging/Kconfig.template.log_config"

endif # APP_MEMFAULT
```

## applications/93m1/src/modules/modem_at/Kconfig.modem_at
```kconfig
#
# Copyright (c) 2026 Nordic Semiconductor ASA
#
# SPDX-License-Identifier: LicenseRef-Nordic-5-Clause
#

menuconfig APP_MODEM_AT
	bool "Modem AT handler (shared DLCI 3)"
	default y
	select MODEM_AT_USER_PIPE
	help
	  Owns the single host AT user pipe (DLCI 3) with its own modem_chat and
	  serialises access between the `modem at` shell and application modules.
	  Replaces the in-tree CONFIG_MODEM_AT_SHELL, which must be disabled.

if APP_MODEM_AT

config APP_MODEM_AT_SHELL
	bool "modem at shell command"
	default y if SHELL
	help
	  Re-adds the interactive `modem at "<command>"` shell on top of the
	  shared handler.

config APP_MODEM_AT_COMMAND_MAX_SIZE
	int "Maximum AT command length"
	default 128

config APP_MODEM_AT_RESPONSE_MAX_SIZE
	int "Maximum collected AT response size"
	default 1024

config APP_MODEM_AT_CHAT_RECEIVE_BUF_SIZE
	int "Chat receive buffer size"
	default 256

config APP_MODEM_AT_TIMEOUT_SECONDS
	int "Default AT command timeout (seconds)"
	default 30

module = APP_MODEM_AT
module-str = modem_at
source "subsys/logging/Kconfig.template.log_config"

endif # APP_MODEM_AT
```

## applications/93m1_at/src/Kconfig.main
```kconfig
#
# Copyright (c) 2026 Nordic Semiconductor ASA
#
# SPDX-License-Identifier: LicenseRef-Nordic-5-Clause
#

menu "Main"

config APP_SYNC_INTERVAL
	int "Sync interval (seconds)"
	default 600
	help
	  Period between cloud syncs. One timer in the main state machine drives both
	  the location fix and the battery report each cycle.

config APP_SYNC_BOOT_DELAY_SECONDS
	int "Delay before the first sync after connect (seconds)"
	default 5

config APP_MAIN_WATCHDOG_TIMEOUT_SECONDS
	int "Watchdog timeout"
	default 300

config APP_MAIN_MSG_PROCESSING_TIMEOUT_SECONDS
	int "Maximum message processing time"
	default 290

module = APP_MAIN
module-str = Main
source "subsys/logging/Kconfig.template.log_config"

endmenu
```

## applications/93m1_at/src/modules/modem_at/Kconfig.modem_at
```kconfig
#
# Copyright (c) 2026 Nordic Semiconductor ASA
#
# SPDX-License-Identifier: LicenseRef-Nordic-5-Clause
#

menuconfig APP_MODEM_AT
	bool "Modem AT handler (shared DLCI 3)"
	default y
	select MODEM_AT_USER_PIPE
	help
	  Shared AT request/response API over the modem's host pipe (DLCI 3).

if APP_MODEM_AT

config APP_MODEM_AT_SHELL
	bool "modem at shell command"
	default y if SHELL
	help
	  Re-adds the interactive `modem at "<command>"` shell on top of the shared
	  handler.

config APP_MODEM_AT_COMMAND_MAX_SIZE
	int "Maximum AT command length"
	default 256

config APP_MODEM_AT_RESPONSE_MAX_SIZE
	int "Maximum collected AT response size"
	default 1024

config APP_MODEM_AT_CHAT_RECEIVE_BUF_SIZE
	int "Chat receive buffer size"
	default 1024
	help
	  Must hold the longest single response line (e.g. a registration JWT from
	  %REGJWT) plus the longest match.

config APP_MODEM_AT_TIMEOUT_SECONDS
	int "Default AT command timeout (seconds)"
	default 30

config APP_MODEM_AT_URC_SUBSCRIBERS
	int "Maximum URC subscribers"
	default 4

module = APP_MODEM_AT
module-str = modem_at
source "subsys/logging/Kconfig.template.log_config"

endif # APP_MODEM_AT
```

## applications/93m1_at/src/modules/network/Kconfig.network
```kconfig
#
# Copyright (c) 2026 Nordic Semiconductor ASA
#
# SPDX-License-Identifier: LicenseRef-Nordic-5-Clause
#

menuconfig APP_NETWORK
	bool "Network module"
	default y
	depends on NET_CONNECTION_MANAGER
	help
	  Drives connectivity through conn_mgr / net_mgmt. The cellular modem driver
	  brings the PPP link up automatically; this module only reflects L4 state and
	  exposes connect/disconnect requests over zbus. No host IP traffic is sent.

if APP_NETWORK

config APP_NETWORK_THREAD_STACK_SIZE
	int "Thread stack size"
	default 2048

config APP_NETWORK_WATCHDOG_TIMEOUT_SECONDS
	int "Watchdog timeout"
	default 300

config APP_NETWORK_MSG_PROCESSING_TIMEOUT_SECONDS
	int "Maximum message processing time"
	default 290

config APP_NETWORK_SEARCH_NETWORK_ON_STARTUP
	bool "Connect to network on startup"
	default y

module = APP_NETWORK
module-str = Network
source "subsys/logging/Kconfig.template.log_config"

endif
```

## applications/93m1_ppp/src/modules/network/Kconfig.network
```kconfig
#
# Copyright (c) 2026 Nordic Semiconductor ASA
#
# SPDX-License-Identifier: LicenseRef-Nordic-5-Clause
#

menuconfig APP_NETWORK
	bool "Network module"
	default y

if APP_NETWORK

config APP_NETWORK_THREAD_STACK_SIZE
	int "Thread stack size"
	default 2048

config APP_NETWORK_WATCHDOG_TIMEOUT_SECONDS
	int "Watchdog timeout"
	default 120

config APP_NETWORK_MSG_PROCESSING_TIMEOUT_SECONDS
	int "Maximum message processing time"
	default 110

config APP_NETWORK_SEARCH_NETWORK_ON_STARTUP
	bool "Connect to network on startup"
	default y

module = APP_NETWORK
module-str = Network
source "subsys/logging/Kconfig.template.log_config"

endif
```
