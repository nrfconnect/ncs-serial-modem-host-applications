/*
 * Copyright (c) 2026 Nordic Semiconductor ASA
 *
 * SPDX-License-Identifier: LicenseRef-Nordic-5-Clause
 *
 * Serial Modem node, included in the modem UART node by the board overlay.
 */

modem: modem {
	compatible = "nordic,nrf91-sm-v2";
	status = "okay";
	mdm-reset-gpios = <&gpio1 10 (GPIO_ACTIVE_LOW | GPIO_OPEN_DRAIN)>;
	mdm-ring-gpios = <&gpio1 12 (GPIO_ACTIVE_LOW | GPIO_PULL_UP)>;
	mdm-dtr-gpios = <&gpio1 11 GPIO_ACTIVE_LOW>;
	zephyr,pm-device-runtime-auto;
	autostarts;
	/* The Serial Modem powers down its UART on DTR deassert and asserts RI when it has
	 * data for the host. Close the host UART after 2 s without traffic.
	 */
	cmux-enable-runtime-power-save;
	cmux-close-pipe-on-power-save;
	cmux-idle-timeout-ms = <2000>;
};
