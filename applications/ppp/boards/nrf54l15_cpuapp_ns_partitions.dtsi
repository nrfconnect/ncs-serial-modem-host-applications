/*
 * Copyright (c) 2026 Nordic Semiconductor ASA
 *
 * SPDX-License-Identifier: LicenseRef-Nordic-5-Clause
 *
 * SRAM layout (cpuapp_sram, 256 KiB):
 * |
 * +-- 0x0000_0000 sram0_s                     (  32 KiB) TF-M secure
 * +-- 0x0000_8000 sram0_ns                    ( 224 KiB) Zephyr/app non-secure
 *
 * RRAM and external flash layout: see nrf54l15_cpuapp_mcuboot_partitions.dtsi.
 * Memory-optimized SFN TF-M sizing (see prj.conf).
 */

/delete-node/ &slot0_s_partition;
/delete-node/ &storage_partition;
/delete-node/ &slot0_ns_partition;
/delete-node/ &tfm_its_partition;
/delete-node/ &tfm_otp_partition;
/delete-node/ &tfm_ps_partition;
/delete-node/ &sram0_s;
/delete-node/ &sram0_ns;

#include "nrf54l15_cpuapp_mcuboot_partitions.dtsi"

&cpuapp_sram {
	sram0_s: image_s@0 {
		#address-cells = <1>;
		#size-cells = <1>;
		reg = <0x0 DT_SIZE_K(32)>;
		ranges = <0x0 0x0 DT_SIZE_K(32)>;
	};

	sram0_ns: image_ns@8000 {
		#address-cells = <1>;
		#size-cells = <1>;
		reg = <0x8000 DT_SIZE_K(224)>;
		ranges = <0x0 0x8000 DT_SIZE_K(224)>;
	};
};
